## kernel/kernel/src/allocator/Kconfig
```kconfig
# Memory allocation algorithm configuration

choice
    prompt "Memory allocation algorithm"
    default ALLOCATOR_TLSF
    config ALLOCATOR_TLSF
        bool "TLSF algorithm"
    config ALLOCATOR_SLAB
        bool "SLAB algorithm (static)"
    config ALLOCATOR_SLAB_DYNAMIC
        bool "SLAB algorithm (dynamic, with page pool)"
        select ALLOCATOR_BUDDY
    config ALLOCATOR_LLFF
        bool "LLFF algorithm"
endchoice

config ALLOCATOR
    string
    default "tlsf" if ALLOCATOR_TLSF
    default "slab" if ALLOCATOR_SLAB
    default "slab_dynamic" if ALLOCATOR_SLAB_DYNAMIC
    default "llff" if ALLOCATOR_LLFF

config SLAB_DEBUG
    bool "Enable SLAB allocator debug logging"
    default n
    depends on ALLOCATOR_SLAB || ALLOCATOR_SLAB_DYNAMIC
    help
      Enable debug logging for SLAB allocator operations including
      page allocation, deallocation, and pool management.

config SLAB_DYNAMIC_MAX_TOTAL_PAGES
    int "Max total pages in page pool"
    default 32
    depends on ALLOCATOR_SLAB_DYNAMIC

config ALLOCATOR_BUDDY
    bool "Enable buddy allocator as dynamic slab backend (or standalone unit tests)"
    default n
    help
        This option is selected automatically by dynamic slab. It may also be
        enabled independently in test builds to include the standalone buddy
        allocator unit tests.

        Dynamic slab obtains its pages from buddy and forwards requests larger
        than 2048 bytes to buddy. Other heap implementations do not forward
        GlobalAlloc requests to the buddy allocator.
```
